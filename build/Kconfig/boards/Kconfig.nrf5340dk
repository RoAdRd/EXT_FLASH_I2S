## build/Kconfig/boards/Kconfig.nrf5340dk
```kconfig
# Load board Kconfig descriptions.
osource "/opt/nordic/ncs/v2.9.0/zephyr/boards/nordic/nrf5340dk/Kconfig.nrf5340dk"
```

## build/spi_flash/Kconfig/Kconfig.shield
```kconfig
osource "/opt/nordic/ncs/v2.9.0/zephyr/samples/drivers/spi_flash/boards/shields/*/Kconfig.shield"
osource "/opt/nordic/ncs/v2.9.0/nrf/boards/shields/*/Kconfig.shield"
```

## build/spi_flash/Kconfig/Kconfig.shield.defconfig
```kconfig
osource "/opt/nordic/ncs/v2.9.0/zephyr/samples/drivers/spi_flash/boards/shields/*/Kconfig.defconfig"
osource "/opt/nordic/ncs/v2.9.0/nrf/boards/shields/*/Kconfig.defconfig"
```
